VERSION "0.2 20180911"

NS_ :

BS_:

BU_: Host SFP200
VAL_TABLE_ Register_addresses 128 "Temperature, m Celcius" 98 "Voltage 2, uV" 97 "Voltage 1, uV" 96 "Voltage 0, uV" 71 "CC Discharging High, uC" 70 "CC Discharging Low, uC" 69 "CC Charging High, uC" 68 "CC Charging Low, uC" 66 "Coulomb Count Low & Reset, uC" 65 "Coulomb Count High, uC" 64 "Coulomb Count Low, uC" 32 "Current, uA" 11 "Serial number 3, ASCII" 10 "Serial number 2, ASCII" 9 "Serial number 1, ASCII" 8 "Serial number 0, ASCII" 7 "Version 2, ASCII" 6 "Version 1, ASCII" 5 "Version 0, ASCII" 4 "Part name 3, ASCII" 3 "Part name 2, ASCII" 2 "Part name 1, ASCII" 1 "Part name 0, ASCII" 0 "Reserved" ;

BO_ 2316304897 Request_data: 1 Host
 SG_ Read_from_address M : 7|8@0+ (1,0) [0|0] ""  SFP200

BO_ 2316304896 Register_data: 5 SFP200
 SG_ Version_2 m7 : 8|32@1+ (1,0) [0|0] "" Vector__XXX
 SG_ Version_1 m6 : 8|32@1+ (1,0) [0|0] "" Vector__XXX
 SG_ Version_0 m5 : 8|32@1+ (1,0) [0|0] "" Vector__XXX
 SG_ Serial_number_3 m11 : 8|32@1+ (1,0) [0|0] "" Vector__XXX
 SG_ Serial_number_2 m10 : 8|32@1+ (1,0) [0|0] "" Vector__XXX
 SG_ Serial_number_1 m9 : 8|32@1+ (1,0) [0|0] "" Vector__XXX
 SG_ Serial_number_0 m8 : 8|32@1+ (1,0) [0|0] "" Vector__XXX
 SG_ Part_name_3 m4 : 8|32@1+ (1,0) [0|0] "" Vector__XXX
 SG_ Part_name_2 m3 : 8|32@1+ (1,0) [0|0] "" Vector__XXX
 SG_ Part_name_1 m2 : 8|32@1+ (1,0) [0|0] "" Vector__XXX
 SG_ Part_name_0 m1 : 8|32@1+ (1,0) [0|0] "" Vector__XXX
 SG_ Temperature m128 : 15|32@0- (1,0) [0|0] "mC" Vector__XXX
 SG_ Voltage_2 m98 : 15|32@0- (1,0) [0|0] "uV" Vector__XXX
 SG_ Voltage_1 m97 : 15|32@0- (1,0) [0|0] "uV" Vector__XXX
 SG_ Voltage_0 m96 : 15|32@0- (1,0) [0|0] "uV" Vector__XXX
 SG_ CC_discharging_high m71 : 15|32@0- (1,0) [0|0] "uC*2^32" Vector__XXX
 SG_ CC_discharging_low m70 : 15|32@0- (1,0) [0|0] "uC" Vector__XXX
 SG_ CC_charging_high m69 : 15|32@0- (1,0) [0|0] "uC*2^32" Vector__XXX
 SG_ CC_charging_low m68 : 15|32@0- (1,0) [0|0] "uC" Vector__XXX
 SG_ CC_low_and_reset m66 : 15|32@0- (1,0) [0|0] "uC" Vector__XXX
 SG_ CC_high m65 : 15|32@0- (1,0) [0|0] "uC*2^32" Vector__XXX
 SG_ CC_low m64 : 15|32@0- (1,0) [0|0] "uC" Vector__XXX
 SG_ Current m32 : 15|32@0- (1,0) [0|0] "uA" Vector__XXX
 SG_ Register_address_mux M : 7|8@0+ (1,0) [0|0] ""  Host

CM_ SG_ 2316304896 CC_low_and_reset "Reading this register will force the whole 64-bit coulomb counter to reset to zero. The value of CC_high will be latched. The user may complete the
read of CC_high to determine the last value prior to the reset.";
BA_DEF_  "DBName" STRING ;
BA_DEF_  "BusType" STRING ;
BA_DEF_DEF_  "DBName" "";
BA_DEF_DEF_  "BusType" "";
BA_ "BusType" "CAN";
BA_ "DBName" "sfp200";
VAL_ 2316304897 Read_from_address 128 "Temperature, m Celcius" 98 "Voltage 2, uV" 97 "Voltage 1, uV" 96 "Voltage 0, uV" 71 "CC Discharging High, uC" 70 "CC Discharging Low, uC" 69 "CC Charging High, uC" 68 "CC Charging Low, uC" 66 "Coulomb Count Low & Reset, uC" 65 "Coulomb Count High, uC" 64 "Coulomb Count Low, uC" 32 "Current, uA" 11 "Serial number 3, ASCII" 10 "Serial number 2, ASCII" 9 "Serial number 1, ASCII" 8 "Serial number 0, ASCII" 7 "Version 2, ASCII" 6 "Version 1, ASCII" 5 "Version 0, ASCII" 4 "Part name 3, ASCII" 3 "Part name 2, ASCII" 2 "Part name 1, ASCII" 1 "Part name 0, ASCII" 0 "Reserved" ;
VAL_ 2316304896 Register_address_mux 128 "Temperature, m Celcius" 98 "Voltage 2, uV" 97 "Voltage 1, uV" 96 "Voltage 0, uV" 71 "CC Discharging High, uC" 70 "CC Discharging Low, uC" 69 "CC Charging High, uC" 68 "CC Charging Low, uC" 66 "Coulomb Count Low & Reset, uC" 65 "Coulomb Count High, uC" 64 "Coulomb Count Low, uC" 32 "Current, uA" 11 "Serial number 3, ASCII" 10 "Serial number 2, ASCII" 9 "Serial number 1, ASCII" 8 "Serial number 0, ASCII" 7 "Version 2, ASCII" 6 "Version 1, ASCII" 5 "Version 0, ASCII" 4 "Part name 3, ASCII" 3 "Part name 2, ASCII" 2 "Part name 1, ASCII" 1 "Part name 0, ASCII" 0 "Reserved" ;
SIG_GROUP_ 2316304896 Serial_number 1 : Serial_number_3 Serial_number_2 Serial_number_1 Serial_number_0;
SIG_GROUP_ 2316304896 Version 1 : Version_2 Version_1 Version_0;
SIG_GROUP_ 2316304896 Part_number 1 : Part_name_3 Part_name_2 Part_name_1 Part_name_0;
SIG_GROUP_ 2316304896 CC_Charging 1 : CC_charging_low CC_charging_high;
SIG_GROUP_ 2316304896 CC_Discharging 1 : CC_discharging_low CC_discharging_high;
SIG_GROUP_ 2316304896 Voltages 1 : Voltage_2 Voltage_1 Voltage_0;
SIG_GROUP_ 2316304896 Coulomb_Count 1 : CC_low CC_high;
